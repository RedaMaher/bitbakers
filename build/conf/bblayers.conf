## build/conf/bblayers.conf
```bitbake
BBPATH = "${TOPDIR}"
BBLAYERS = "${TOPDIR}/../meta-core ${TOPDIR}/../meta-bsp ${TOPDIR}/../meta-distro"
```

## build/conf/local.conf
```bitbake
MACHINE = "versatilepb"
DISTRO = "bitbaker"
BB_NUMBER_THREADS = "2"
PARALLEL_MAKE = "-j 4"
```

## ch08/meta-tutorial/conf/layer.conf
```bitbake
BBPATH .= ":${LAYERDIR}"
BBFILES += "${LAYERDIR}/recipes-*/*/*.bb" 
BBFILE_COLLECTIONS += "tutorial"
BBFILE_PATTERN_tutorial = "^${LAYERDIR}/"
BBFILE_PRIORITY_tutorial = "5"

LAYERSERIES_CORENAMES = "bitbakeguide"

LAYERVERSION_tutorial = "1"
LAYERSERIES_COMPAT_tutorial = "bitbakeguide"
```

## ch08/meta-two/conf/layer.conf
```bitbake
BBPATH .= ":${LAYERDIR}"
BBFILES += "${LAYERDIR}/recipes-*/*/*.bb \
${LAYERDIR}/recipes-*/*/*.bbappend" 

BBFILE_COLLECTIONS += "two"
BBFILE_PATTERN_two = "^${LAYERDIR}/"
BBFILE_PRIORITY_two = "5"
LAYERVERSION_two = "1"
LAYERDEPENDS_two = "tutorial"

LAYERSERIES_COMPAT_two = "bitbakeguide"
```

## meta-bsp/conf/layer.conf
```bitbake
BBPATH .= ":${LAYERDIR}"
BBFILES += "${LAYERDIR}/recipes-*/*/*.bb"
BBFILE_COLLECTIONS += "bsp"
BBFILE_PATTERN_bsp = "^${LAYERDIR}/"
BBFILE_PRIORITY_bsp = "10"
LAYERDEPENDS_bsp = "core"
LAYERSERIES_COMPAT_bsp = "bitbaker-1"
```

## meta-core/conf/distro/bitbaker.conf
```bitbake
DISTRO_NAME = "BitBaker Linux"
DISTRO_VERSION = "1.0"
IMAGE_ROOTFS_SIZE = "65536"
IMAGE_LABEL = "bitbaker"
```

## meta-core/conf/layer.conf
```bitbake
BBPATH .= ":${LAYERDIR}"
BBFILES += "${LAYERDIR}/recipes-*/*/*.bb"
BBFILE_COLLECTIONS += "core"
BBFILE_PATTERN_core = "^${LAYERDIR}/"
BBFILE_PRIORITY_core = "5"
LAYERSERIES_CORENAMES = "bitbaker-1"
LAYERSERIES_COMPAT_core = "bitbaker-1"
```

## meta-core/conf/machine/versatilepb.conf
```bitbake
TARGET_ARCH = "arm"
TARGET_PREFIX = "arm-linux-gnueabi-"
KERNEL_DEFCONFIG = "versatile_defconfig"
KERNEL_DEVICETREE = "qemu-versatile-pb.dtb"
QEMU_MACHINE = "versatilepb"
QEMU_MEM = "128"
QEMU_APPEND = "console=ttyAMA0 root=/dev/mmcblk0 rootwait rw"
```

## meta-distro/conf/layer.conf
```bitbake
BBPATH .= ":${LAYERDIR}"
BBFILES += "${LAYERDIR}/recipes-*/*/*.bb"
BBFILE_COLLECTIONS += "distro"
BBFILE_PATTERN_distro = "^${LAYERDIR}/"
BBFILE_PRIORITY_distro = "10"
LAYERDEPENDS_distro = "core bsp"
LAYERSERIES_COMPAT_distro = "bitbaker-1"
```
